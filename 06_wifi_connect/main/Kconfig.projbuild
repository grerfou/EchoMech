## 06_wifi_connect/main/Kconfig.projbuild
```kconfig
menu "EchoMesh Configuration"

    config WIFI_SSID
        string "WiFi SSID"
        default "myssid"
        help
            SSID du reseau Wi-Fi.

    config WIFI_PASSWORD
        string "WiFi Password"
        default "mypassword"
        help
            Mot de passe du reseau Wi-Fi.

    config WIFI_MAX_RETRY
        int "Max reconnexion attempts"
        default 10
        help
            Nombre max de tentatives avant erreur fatale.

endmenu
```

## 08_mqtt_local/main/Kconfig.projbuild
```kconfig
menu "EchoMesh Configuration"

    config WIFI_SSID
        string "WiFi SSID"
        default "myssid"
        help
            SSID du reseau Wi-Fi.

    config WIFI_PASSWORD
        string "WiFi Password"
        default "mypassword"
        help
            Mot de passe du reseau Wi-Fi.

    config WIFI_MAX_RETRY
        int "Max reconnexion attempts"
        default 10
        help
            Nombre max de tentatives avant erreur fatale.

    config MQTT_BROKER_IP
        string "MQTT Broker IP"
        default "192.168.1.1"
        help
            IP du broker MQTT local (Mosquitto).

    config MQTT_BROKER_PORT
        int "MQTT Broker Port"
        default 1883
        help
            Port du broker MQTT.

endmenu
```

## 13_deep_sleep/main/Kconfig.projbuild
```kconfig
menu "EchoMesh Configuration"

    config WIFI_SSID
        string "WiFi SSID"
        default "myssid"
        help
            SSID du reseau Wi-Fi.

    config WIFI_PASSWORD
        string "WiFi Password"
        default "mypassword"
        help
            Mot de passe du reseau Wi-Fi.

    config WIFI_MAX_RETRY
        int "Max reconnexion attempts"
        default 10
        help
            Nombre max de tentatives avant erreur fatale.

    config MQTT_BROKER_URL
        string "HiveMQ Cloud URL"
        default "f14a117fb9474a3a8d1ef491a81347ef.s1.eu.hivemq.cloud"
        help
            URL du broker HiveMQ Cloud.

    config MQTT_BROKER_PORT
        int "MQTT Broker Port"
        default 8883
        help
            Port TLS du broker.

    config MQTT_USERNAME
        string "MQTT Username"
        default ""
        help
            Username HiveMQ Cloud.

    config MQTT_PASSWORD
        string "MQTT Password"
        default ""
        help
            Password HiveMQ Cloud.

    config SLEEP_DURATION_SEC
        int "Deep sleep duration (seconds)"
        default 10
        range 5 3600
        help
            Duree du deep sleep entre deux mesures.

endmenu
```

## firmware/sdkconfig.defaults
```kconfig
# sdkconfig.defaults — committé dans git, pas de credentials ici
CONFIG_WIFI_SSID=""
CONFIG_WIFI_PASSWORD=""
CONFIG_MQTT_BROKER_URL="placeholder.hivemq.cloud"
CONFIG_MQTT_BROKER_PORT=8883
CONFIG_MQTT_USERNAME=""
CONFIG_MQTT_PASSWORD=""
CONFIG_SLEEP_DURATION_SEC=10

CONFIG_PARTITION_TABLE_CUSTOM=y
CONFIG_PARTITION_TABLE_CUSTOM_FILENAME="partitions.csv"
CONFIG_PARTITION_TABLE_FILENAME="partitions.csv"
CONFIG_PARTITION_TABLE_OFFSET=0x8000
CONFIG_PARTITION_TABLE_MD5=y

CONFIG_ESPTOOLPY_FLASHSIZE_32MB=y
CONFIG_ESPTOOLPY_FLASHSIZE="32MB"
```
